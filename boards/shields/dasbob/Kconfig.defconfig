## boards/shields/dasbob/Kconfig.defconfig
```kconfig
# Copyright (c) 2021 The ZMK Contributors
# SPDX-License-Identifier: MIT

if SHIELD_DASBOB_DONGLE

config ZMK_KEYBOARD_NAME
	default "dasbob"

config ZMK_SPLIT_ROLE_CENTRAL
	default y

config ZMK_SPLIT_BLE_CENTRAL_PERIPHERALS
	default 2

config ZMK_KEYPEEK_LAYER_NOTIFIER
	default n if !SHIELD_RAW_HID_ADAPTER

endif

if SHIELD_DASBOB_LEFT || SHIELD_DASBOB_RIGHT || SHIELD_DASBOB_DONGLE

config ZMK_SPLIT
	default y

endif
```
